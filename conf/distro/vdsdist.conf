## conf/distro/vdsdist.conf
```bitbake
# Modified version of poky
require conf/distro/poky.conf   
# distro name  
DISTRO = "vdsdist"      
DISTRO_NAME = "Valid Display Systems Distribution"      
DISTRO_VERSION = "1.0"      
DISTRO_CODENAME = "vds"       
DISTRO_FEATURES_remove = "x11 wayland directfb harfbuzz cairo 3g pci wifi bluetooth bluez bluez4 bluez5 pango mesa pulseaudio gdk-pixbuff "
SDK_VENDOR = "-vdsdistsdk"      
SDK_VERSION := "${@'${DISTRO_VERSION}'.replace('snapshot-${DATE}','snapshot')}"      
MAINTAINER = "vdsdist "      
INHERIT += "buildhistory"      
BUILDHISTORY_COMMIT = "1"  

# Disable terminal prompt on main display
USE_VT = ""
SYSVINIT_ENABLED_GETTYS = ""

KERNEL_DEVICETREE = "imx6q-nitrogen6_som2.dtb"

# Add files to 
# BOOT_SCRIPTS_append = "" 
BOOT_SCRIPTS = "6x_bootscript-${MACHINE}:6x_bootscript \
                6x_upgrade-${MACHINE}:6x_upgrade \
                u-boot-${MACHINE}.imx:u-boot.nitrogen6q_som2_1g \               
"
```

## conf/layer.conf
```bitbake
# We have a conf and classes directory, add to BBPATH 
BBPATH := "${BBPATH}:${LAYERDIR}" 
# We have a packages directory, add to BBFILES 
BBFILES := "${BBFILES} ${LAYERDIR}/recipes-*/*/*.bb \ 
           ${LAYERDIR}/recipes-*/*/*.bbappend" 
BBFILE_COLLECTIONS += "valid-display-systems"
BBFILE_PATTERN_valid-display-systems := "^${LAYERDIR}/" 
BBFILE_PRIORITY_valid-display-systems := "99"
```
